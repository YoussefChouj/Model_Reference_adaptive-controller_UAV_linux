// ------------------------------------------------------------------------------
// MRAC Implementation File
// ------------------------------------------------------------------------------
// Contains the core adaptive control logic for the 4 axes of a free-flying
// quadcopter (Pitch, Roll, Yaw, Z-Axis).
// ------------------------------------------------------------------------------

#include "mrac.h"
#include "mrac_math.h"
#include <math.h>

// Global instance of the MRAC runtime states
MRAC_State_t mrac_state;
MRAC_FeatureFlags_t mrac_flags = {0};

// Global configurations for the 4 axes
MRAC_AxisConfig_t mrac_config_pitch;
MRAC_AxisConfig_t mrac_config_roll;
MRAC_AxisConfig_t mrac_config_yaw;
MRAC_AxisConfig_t mrac_config_z;

// Supplied by SINS/baro-IMU fusion — wire this before flight test.

// TODO [HW-PARAM]: identify from motor characterization
#define MOTOR_CT 0.0f




// ------------------------------------------------------------------------------
// Helper: Inverse Mixer
// ------------------------------------------------------------------------------
// Extracts the equivalent mechanical torque/thrust generated by the motors 
// purely from the current actual PWM values and Battery Voltage.
// Needed for actuator loss-of-effectiveness (LOE) estimation and 
// calculating saturation limits for hedging.
static void MRAC_InverseMixer(float current_vbatt, float pwm1, float pwm2, float pwm3, float pwm4,
                              float* u_pitch_actual, float* u_roll_actual, float* u_yaw_actual, float* u_z_actual)
{
    // TODO [HW-PARAM]: Tune c_T thrust coefficient and mixer geometry.
    // Assuming standard Quad-X configuration:
    // Thrust_i = MOTOR_CT * (pwm_i * current_vbatt)^2
    
    // float t1 = MOTOR_CT * (pwm1 * current_vbatt) * (pwm1 * current_vbatt);
    // float t2 = MOTOR_CT * (pwm2 * current_vbatt) * (pwm2 * current_vbatt);
    // float t3 = MOTOR_CT * (pwm3 * current_vbatt) * (pwm3 * current_vbatt);
    // float t4 = MOTOR_CT * (pwm4 * current_vbatt) * (pwm4 * current_vbatt);
    
    // Reverse mix for Quad-X
    // *u_pitch_actual = (t1 + t2 - t3 - t4);
    // *u_roll_actual  = (t1 - t2 + t3 - t4);
    // *u_yaw_actual   = (t1 - t2 - t3 + t4);
    // *u_z_actual     = (t1 + t2 + t3 + t4); // Total vertical thrust
    
    *u_pitch_actual = 0.0f; // Placeholder until wired
    *u_roll_actual  = 0.0f; // Placeholder until wired
    *u_yaw_actual   = 0.0f; // Placeholder until wired
    *u_z_actual     = 0.0f; // Placeholder until wired
}

// ------------------------------------------------------------------------------
// Helper: Regressor Generator (Structured Physics-Based)
// ------------------------------------------------------------------------------
// Populates the Phi vector mirroring 6DOF quadcopter physics.
static void MRAC_GenerateStructuredBasis(MRAC_Axis_e axis, MRAC_AxisState_t* state, float cross_coupling)
{
    // Fetch Current state (rate or Vz)
    float x = state->x; 
    
    // Base terms (Bias, Damping, Drag)
    state->Phi[0] = 1.0f;               // Bias
    state->Phi[1] = x;                  // Damping
    state->Phi[2] = x * tanhf(x);       // Nonlinear drag (bounded: saturates at high rate)
    
    // Handle cross-coupling appropriately per axis
    if (axis == MRAC_AXIS_Z || axis == MRAC_AXIS_YAW) {
#if INCLUDE_CONTROL_IN_REGRESSOR == 1
        state->Phi[3] = 0.0f;           // u_nom is already in Phi[4], keep Phi[3] empty to prevent collinear drift
#else
        state->Phi[3] = state->u_nom;   // In 4-term basis, use empty cross-coupling slot for u_nom
#endif
    } else {
        state->Phi[3] = cross_coupling; // Pitch/Roll gyroscopic cross-coupling
    }
    
#if INCLUDE_CONTROL_IN_REGRESSOR == 1
    // Append control features to the regressor
    state->Phi[4] = state->u_nom;       // Control scaling factor
    state->Phi[5] = state->xm;          // Reference feedforward factor
#endif
}

static void MRAC_ProjectGradient(float grad[], const float Theta[], int num_basis,
                                 const float* limit, const float* tol, const float* lower_limit)
{
    int i;

    for (i = 0; i < num_basis; i++) {
        float upper;
        float lower;
        float band;
        float g;
        float w;
        float scale;

        upper = limit[i];
        lower = lower_limit[i];
        band = tol[i];
        g = grad[i];
        w = Theta[i];

        if (band <= 0.0f) {
            if ((w >= upper && g > 0.0f) || (w <= lower && g < 0.0f)) {
                grad[i] = 0.0f;
            }
            continue;
        }

        if (g > 0.0f) {
            if (w >= upper) {
                g = 0.0f;
            } else if (w > (upper - band)) {
                scale = (upper - w) / band;
                if (scale < 0.0f) {
                    scale = 0.0f;
                }
                g *= scale;
            }
        } else if (g < 0.0f) {
            if (w <= lower) {
                g = 0.0f;
            } else if (w < (lower + band)) {
                scale = (w - lower) / band;
                if (scale < 0.0f) {
                    scale = 0.0f;
                }
                g *= scale;
            }
        }

        grad[i] = g;
    }
}

// ------------------------------------------------------------------------------
// Helper: Axis Update Core
// ------------------------------------------------------------------------------
// Runs the core MRAC algorithm for a single axis.
static void MRAC_UpdateAxis(MRAC_Axis_e axis_id, MRAC_AxisState_t* state, const MRAC_AxisConfig_t* config, float cross_coupling, float r)
{
    float P = 1.0f; 
    float Phi_sq;
    float denom;
    float grad[MAX_NUM_BASIS];
    float y;
    float PBe;
    float sigma_e;
    float sigma_eff;
    float sigma_lf_active;
    int do_adaptation;
    int i;
    
    // 1. Update reference model dynamics
    // No reference model for now. Set xm = r (direct instantaneous command passthrough)
    state->xm = r;
    
    // 2. Compute tracking error (e = x - xm)
    state->e = state->x - state->xm;
    
    // 3. Compute nominal control (done externally)
    
    // 4. Generate Basis/Regressor vector (Phi)
#if USE_STRUCTURED_UNCERTAINTY == 1
    MRAC_GenerateStructuredBasis(axis_id, state, cross_coupling);
#endif
    
    // 5. Update adaptive weights using Lyapunov gradient descent
    Phi_sq = MRAC_VectorNormSquare(state->Phi, MAX_NUM_BASIS);
    denom = 1.0f + Phi_sq;

    // Proceed with adaptation only if error is outside deadzone
    do_adaptation = (!mrac_flags.deadzone_on) || (fabsf(state->e) >= config->e_deadzone);

    // Hard freeze: zero adaptive output and skip updates during large error spikes
    if (mrac_flags.hard_freeze_on && config->e_freeze > 0.0f && fabsf(state->e) > config->e_freeze) {
        // Freeze pauses adaptation/output only; Theta is intentionally preserved.
        state->u_ad = 0.0f;
        return;
    }

    PBe = state->e;

    // Tanh saturation: bound effective error to ±e_sat regardless of spike magnitude
    if (mrac_flags.tanh_saturation_on && config->e_sat > 0.0f) {
        PBe = config->e_sat * tanhf(PBe / config->e_sat);
    }

    if (mrac_flags.adaptation_on && do_adaptation) {
        sigma_e = 0.0f;
        if (mrac_flags.e_modification_on) {
            sigma_e = config->k_e * fabsf(state->e);
        }
        sigma_eff = config->sigma + sigma_e;
        sigma_lf_active = mrac_flags.l1_filtering_on ? config->sigma_lf : 0.0f;

        for (i = 0; i < MAX_NUM_BASIS; i++) {
            grad[i] = (-PBe * P * state->Phi[i]) / denom;
        }

        if (mrac_flags.projection_on) {
            MRAC_ProjectGradient(grad, state->Theta, MAX_NUM_BASIS,
                                 config->What_limit, config->What_tol, config->What_lower_limit);
        }

        for (i = 0; i < MAX_NUM_BASIS; i++) {
            y = config->gamma[i] * (grad[i]
                - sigma_lf_active * (state->Theta[i] - state->Whatf[i]) / denom
                - sigma_eff * state->Theta[i] / denom);

            state->Theta[i] += MRAC_DT * y;

            // L1-style low-frequency leakage: pull fast weights toward filtered copy
            if (mrac_flags.l1_filtering_on) {
                state->Whatf[i] += MRAC_DT * config->gam_f * (state->Theta[i] - state->Whatf[i]);
            }
        }
    }
    
    // 6. Compute adaptive control component (u_ad = Theta^T * Phi)
    state->u_ad = 0.0f;
    for (i = 0; i < MAX_NUM_BASIS; i++) {
        state->u_ad += state->Theta[i] * state->Phi[i];
    }
}

// ------------------------------------------------------------------------------
// Public API Operations
// ------------------------------------------------------------------------------

void MRAC_Init(void)
{
    // Tuning parameters for Pitch/Roll (Identical geometry)
    // Gamma: learning rates for [bias, damping, drag, cross-coupling, u_nom, xm]
    float PR_Gamma[6] = {1.5f, 0.2f, 0.05f, 0.05f, 0.1f, 0.1f};
    float Yaw_Gamma[6] = {1.0f, 0.1f, 0.05f, 0.05f, 0.1f, 0.1f};
    float Z_Gamma[6]   = {2.0f, 0.5f, 0.10f, 0.10f, 0.2f, 0.2f};

    // Limits and tolerances (Max disturbance authority)
    float PR_Wlim[6] = {0.15f, 0.05f, 0.02f, 0.05f, 0.20f, 0.15f};
    float PR_Wtol[6] = {0.03f, 0.01f, 0.005f, 0.01f, 0.04f, 0.03f};
    
    float Z_Wlim[6] = {1.00f, 0.10f, 0.05f, 0.05f, 0.20f, 0.20f};
    float Z_Wtol[6] = {0.20f, 0.02f, 0.01f, 0.01f, 0.04f, 0.04f};
    int i;

    for (i = 0; i < MAX_NUM_BASIS; i++) {
        // Pitch
        mrac_config_pitch.gamma[i]      = PR_Gamma[i];
        mrac_config_pitch.What_limit[i] = PR_Wlim[i];
        mrac_config_pitch.What_tol[i]   = PR_Wtol[i];
        
        // Roll
        mrac_config_roll.gamma[i]       = PR_Gamma[i];
        mrac_config_roll.What_limit[i]  = PR_Wlim[i];
        mrac_config_roll.What_tol[i]    = PR_Wtol[i];
        
        // Yaw
        mrac_config_yaw.gamma[i]        = Yaw_Gamma[i];
        mrac_config_yaw.What_limit[i]   = PR_Wlim[i] * 0.6f; // Smaller authorities for yaw
        mrac_config_yaw.What_tol[i]     = PR_Wtol[i] * 0.6f;
        
        // Z-Axis
        mrac_config_z.gamma[i]          = Z_Gamma[i];
        mrac_config_z.What_limit[i]     = Z_Wlim[i]; 
        mrac_config_z.What_tol[i]       = Z_Wtol[i];
    }
    
    // Set Scalar Constants: Pitch
    mrac_config_pitch.sigma = 0.01f;
    mrac_config_pitch.e_deadzone = 0.05f;
    mrac_config_pitch.J = 0.0023f; // kg*m^2
    mrac_config_pitch.ref_model_bw = 50.0f;
    mrac_config_pitch.u_max = 6.73863f; // U_MAX_PITCH
    mrac_config_pitch.mrac_to_mixer = DEFAULT_MRAC_TO_MIXER_PR;
    mrac_config_pitch.sigma_lf = 0.8f;
    mrac_config_pitch.gam_f = 16.0f;
    mrac_config_pitch.e_freeze = 5.0f;
    mrac_config_pitch.e_sat = 3.5f;
    mrac_config_pitch.k_e = 0.05f;
    
    // Set Scalar Constants: Roll
    mrac_config_roll.sigma = 0.01f;
    mrac_config_roll.e_deadzone = 0.05f;
    mrac_config_roll.J = 0.0023f; // kg*m^2
    mrac_config_roll.ref_model_bw = 50.0f;
    mrac_config_roll.u_max = 6.73863f; // U_MAX_ROLL
    mrac_config_roll.mrac_to_mixer = DEFAULT_MRAC_TO_MIXER_PR;
    mrac_config_roll.sigma_lf = 0.8f;
    mrac_config_roll.gam_f = 16.0f;
    mrac_config_roll.e_freeze = 5.0f;
    mrac_config_roll.e_sat = 3.5f;
    mrac_config_roll.k_e = 0.05f;

    // Set Scalar Constants: Yaw
    mrac_config_yaw.sigma = 0.01f;
    mrac_config_yaw.e_deadzone = 0.05f;
    mrac_config_yaw.J = 0.0015f; // kg*m^2
    mrac_config_yaw.ref_model_bw = 30.0f;
    mrac_config_yaw.u_max = 2.027f; // U_MAX_YAW
    mrac_config_yaw.mrac_to_mixer = DEFAULT_MRAC_TO_MIXER_YAW;
    mrac_config_yaw.sigma_lf = 1.0f;
    mrac_config_yaw.gam_f = 16.0f;
    mrac_config_yaw.e_freeze = 1.0f;
    mrac_config_yaw.e_sat = 2.0f;
    mrac_config_yaw.k_e = 0.05f;

    // Set Scalar Constants: Z-Axis
    mrac_config_z.sigma = 0.01f;
    mrac_config_z.e_deadzone = 0.05f;
    mrac_config_z.J = 1.5f; // Mass in kg (not inertia)
    mrac_config_z.ref_model_bw = 20.0f; // Slower translation bandwidth
    mrac_config_z.u_max = 13.47726f; // U_MAX_Z
    mrac_config_z.mrac_to_mixer = DEFAULT_MRAC_TO_MIXER_Z;

    mrac_flags.adaptation_on      = ENABLE_MRAC_COMPUTATION;
    mrac_flags.projection_on      = ENABLE_PROJECTION_OPERATOR;
    mrac_flags.deadzone_on        = ENABLE_DEADZONE;
    mrac_flags.hard_freeze_on     = 1;
    mrac_flags.tanh_saturation_on = 1;
    mrac_flags.e_modification_on  = 1;
    mrac_flags.l1_filtering_on    = 0;
    mrac_flags.axis_enable_pitch  = 1;
    mrac_flags.axis_enable_roll   = 1;
    mrac_flags.axis_enable_yaw    = 1;
    
    MRAC_Reset();
}

void MRAC_Reset(void)
{
    int i;
    // Force reference models to snap to current plant states, reset weights.
    // Useful during mid-flight mode switches or disarms safely.
    for (i = 0; i < MAX_NUM_BASIS; i++) {
        mrac_state.pitch.Theta[i] = 0.0f;
        mrac_state.roll.Theta[i]  = 0.0f;
        mrac_state.yaw.Theta[i]   = 0.0f;
        mrac_state.z_rate.Theta[i]= 0.0f;
        mrac_state.pitch.Whatf[i] = 0.0f;
        mrac_state.roll.Whatf[i]  = 0.0f;
        mrac_state.yaw.Whatf[i]   = 0.0f;
        mrac_state.z_rate.Whatf[i]= 0.0f;
    }
    
    // Snap references
    mrac_state.pitch.xm = mrac_state.pitch.x;
    mrac_state.roll.xm  = mrac_state.roll.x;
    mrac_state.yaw.xm   = mrac_state.yaw.x;
    mrac_state.z_rate.xm= mrac_state.z_rate.x;
}

void MRAC_Control(const CtrlerTypeDef* current_state)
{
    float p_rate, q_rate, r_rate;
    float cross_pitch, cross_roll;
    float r_pitch, r_roll, r_yaw, r_z;
    
    // Main execution cycle (Hooked into FreeRTOS / Tasks)
    
    // 1. Acquire current Gyro Rates (p, q, r) and Z-velocity from inner-loop cascade
    // Convert PID FB (degrees/s) to rad/s for regressor bounds alignment
    p_rate = current_state->gyroyPID.FB * 0.0174533f; // Y-axis gyro represents Pitch
    q_rate = current_state->gyroxPID.FB * 0.0174533f; // X-axis gyro represents Roll
    r_rate = current_state->gyrozPID.FB * 0.0174533f; // Z-axis gyro represents Yaw
    
    // Assign measured states
    mrac_state.pitch.x = p_rate;
    mrac_state.roll.x  = q_rate;
    mrac_state.yaw.x   = r_rate;
    mrac_state.z_rate.x = current_state->Z_ratePID.FB; // Z-axis velocity measurement from cascade
    
    // Compute cross-coupling terms
    cross_pitch = q_rate * r_rate;
    cross_roll  = p_rate * r_rate;
    
    // 2. Read current commanded targets streaming from outer loops
    // Degrees/s to Radians/s (for gyro references)
    r_pitch = current_state->gyroyPID.Des * 0.0174533f;
    r_roll  = current_state->gyroxPID.Des * 0.0174533f;
    r_yaw   = current_state->gyrozPID.Des * 0.0174533f;
    r_z     = current_state->Z_ratePID.Des; // Pull desired vertical rate directly
    
    // 3. Assign Nominal Control (U) computed by PID controllers
    // Convert from PWM/Mixer units down to physical torque/thrust SI Units 
    // to prevent regressor norm scaling explosion (1 + ||Phi||^2)
    mrac_state.pitch.u_nom  = current_state->gyroyPID.U / mrac_config_pitch.mrac_to_mixer;
    mrac_state.roll.u_nom   = current_state->gyroxPID.U / mrac_config_roll.mrac_to_mixer;
    mrac_state.yaw.u_nom    = current_state->gyrozPID.U / mrac_config_yaw.mrac_to_mixer;
    mrac_state.z_rate.u_nom = current_state->Z_ratePID.U / mrac_config_z.mrac_to_mixer;
    
    // 4. Perform inverse mixing to measure actual actuation capabilities
    // (Omitted in early dev, rely on basic limits)
    
    // 5-8. Update core MRAC algorithms for all axes
    if (mrac_flags.axis_enable_pitch) {
        MRAC_UpdateAxis(MRAC_AXIS_PITCH, &mrac_state.pitch, &mrac_config_pitch, cross_pitch, r_pitch);
    } else {
        mrac_state.pitch.u_ad = 0.0f;
    }
    if (mrac_flags.axis_enable_roll) {
        MRAC_UpdateAxis(MRAC_AXIS_ROLL,  &mrac_state.roll,  &mrac_config_roll,  cross_roll,  r_roll);
    } else {
        mrac_state.roll.u_ad = 0.0f;
    }
    if (mrac_flags.axis_enable_yaw) {
        MRAC_UpdateAxis(MRAC_AXIS_YAW,   &mrac_state.yaw,   &mrac_config_yaw,   0.0f,        r_yaw);
    } else {
        mrac_state.yaw.u_ad = 0.0f;
    }
    MRAC_UpdateAxis(MRAC_AXIS_Z,     &mrac_state.z_rate,&mrac_config_z,     0.0f,        r_z);
    

}
